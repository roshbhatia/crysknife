## firmware/boards/shields/crysknife/Kconfig.defconfig
```kconfig
if SHIELD_CRYSKNIFE_LEFT || SHIELD_CRYSKNIFE_RIGHT

config ZMK_SPLIT
    default y

config ZMK_SLEEP
    default y

endif

if SHIELD_CRYSKNIFE_RIGHT

config ZMK_KEYBOARD_NAME
    default "crysknife"

config ZMK_SPLIT_ROLE_CENTRAL
    default y

endif
```

## firmware/boards/shields/crysknife/Kconfig.shield
```kconfig
config SHIELD_CRYSKNIFE_LEFT
    def_bool $(shields_list_contains,crysknife_left)

config SHIELD_CRYSKNIFE_RIGHT
    def_bool $(shields_list_contains,crysknife_right)
```

## firmware/boards/shields/fridakeeb/Kconfig.defconfig
```kconfig
if SHIELD_FRIDAKEEB_LEFT || SHIELD_FRIDAKEEB_RIGHT

config ZMK_SPLIT
    default y

endif

if SHIELD_FRIDAKEEB_RIGHT

config ZMK_KEYBOARD_NAME
    default "fridakeys"

config ZMK_SPLIT_ROLE_CENTRAL
    default y

endif
```

## firmware/boards/shields/fridakeeb/Kconfig.shield
```kconfig
config SHIELD_FRIDAKEEB_LEFT
    def_bool $(shields_list_contains,fridakeeb_left)

config SHIELD_FRIDAKEEB_RIGHT
    def_bool $(shields_list_contains,fridakeeb_right)
```

## firmware/config/west.yml
```yaml
manifest:
  projects:
    - name: zmk
      url: https://github.com/zmkfirmware/zmk
      revision: 5b51501fead672c41b5cfb396f3dafe0894bf4e9
      import: app/west.yml
  self:
    path: config
```
